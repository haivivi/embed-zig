## examples/esp/adc_button/zig/sdkconfig.defaults
```kconfig
# ESP32-S3-Korvo-2 V3 with PSRAM
CONFIG_IDF_TARGET="esp32s3"
CONFIG_ESPTOOLPY_FLASHSIZE_4MB=y
CONFIG_SPIRAM=y
CONFIG_SPIRAM_MODE_OCT=y
CONFIG_SPIRAM_SPEED_80M=y

# Compiler optimizations
CONFIG_COMPILER_OPTIMIZATION_SIZE=y

# Logging
CONFIG_LOG_DEFAULT_LEVEL_INFO=y

# Stack size for main task (default 3584 is too small for HAL Board)
CONFIG_ESP_MAIN_TASK_STACK_SIZE=8192
```

## examples/esp/aec_test/sdkconfig.defaults
```kconfig
# Target
CONFIG_IDF_TARGET="esp32s3"

# Flash
CONFIG_ESPTOOLPY_FLASHMODE_QIO=y
CONFIG_ESPTOOLPY_FLASHFREQ_80M=y
CONFIG_ESPTOOLPY_FLASHSIZE_16MB=y

# PSRAM
CONFIG_SPIRAM=y
CONFIG_SPIRAM_MODE_OCT=y
CONFIG_SPIRAM_SPEED_80M=y
CONFIG_SPIRAM_BOOT_INIT=y
CONFIG_SPIRAM_USE_MALLOC=y

# FreeRTOS
CONFIG_FREERTOS_HZ=1000

# Partition table
CONFIG_PARTITION_TABLE_CUSTOM=y
CONFIG_PARTITION_TABLE_CUSTOM_FILENAME="partitions.csv"

# ESP-SR
CONFIG_AFE_INTERFACE_V1=y
```

## examples/esp/gpio_button/zig/sdkconfig.defaults
```kconfig
# ESP32-S3-DevKitC-1 with PSRAM
CONFIG_IDF_TARGET="esp32s3"
CONFIG_ESPTOOLPY_FLASHSIZE_2MB=y
CONFIG_SPIRAM=y
CONFIG_SPIRAM_MODE_OCT=y
CONFIG_SPIRAM_SPEED_80M=y

# Compiler optimizations
CONFIG_COMPILER_OPTIMIZATION_SIZE=y

# Logging
CONFIG_LOG_DEFAULT_LEVEL_INFO=y

# Stack size for main task (prevent overflow with HAL)
CONFIG_ESP_MAIN_TASK_STACK_SIZE=8192
```

## examples/esp/http_speed_test/c/main/Kconfig.projbuild
```kconfig
menu "HTTP Speed Test Configuration"

    config WIFI_SSID
        string "WiFi SSID"
        default "myssid"

    config WIFI_PASSWORD
        string "WiFi Password"
        default "mypassword"

    config TEST_SERVER_IP
        string "Test Server IP"
        default "192.168.1.100"

    config TEST_SERVER_PORT
        int "Test Server Port"
        default 8080

    config TEST_SERVER_PORT_STR
        string "Test Server Port (string)"
        default "8080"

endmenu
```

## examples/esp/http_speed_test/zig/sdkconfig.defaults
```kconfig
# ESP32-S3-DevKitC-1 with PSRAM
CONFIG_IDF_TARGET="esp32s3"
CONFIG_ESPTOOLPY_FLASHSIZE_2MB=y
CONFIG_SPIRAM=y
CONFIG_SPIRAM_MODE_OCT=y
CONFIG_SPIRAM_SPEED_80M=y

# CPU Frequency 240MHz
CONFIG_ESP32S3_DEFAULT_CPU_FREQ_240=y
CONFIG_ESP32S3_DEFAULT_CPU_FREQ_MHZ=240

# Run code from PSRAM (reduces IRAM usage)
CONFIG_SPIRAM_FETCH_INSTRUCTIONS=y
CONFIG_SPIRAM_RODATA=y

# Compiler optimizations
CONFIG_COMPILER_OPTIMIZATION_SIZE=y

# WiFi
CONFIG_WIFI_SSID="HAIVIVI-MFG"
CONFIG_WIFI_PASSWORD="!haivivi"

# Test Server
CONFIG_TEST_SERVER_IP="192.168.4.221"
CONFIG_TEST_SERVER_PORT=8080

# HTTP Client
CONFIG_ESP_HTTP_CLIENT_ENABLE_HTTPS=n
CONFIG_ESP_HTTP_CLIENT_ENABLE_BASIC_AUTH=n

# Disable unused
CONFIG_BT_ENABLED=n

# Increase task stack for HTTP
CONFIG_ESP_MAIN_TASK_STACK_SIZE=8192

# ============================================================================
# WiFi Optimizations for Speed
# ============================================================================
# Use PSRAM for WiFi/LWIP buffers (reduces internal RAM pressure)
CONFIG_SPIRAM_TRY_ALLOCATE_WIFI_LWIP=y

# WiFi RX buffers
CONFIG_ESP_WIFI_STATIC_RX_BUFFER_NUM=16
CONFIG_ESP_WIFI_DYNAMIC_RX_BUFFER_NUM=64

# WiFi TX buffers  
CONFIG_ESP_WIFI_DYNAMIC_TX_BUFFER_NUM=64

# WiFi AMPDU settings (increase TX window for better throughput)
CONFIG_ESP_WIFI_AMPDU_TX_ENABLED=y
CONFIG_ESP_WIFI_AMPDU_RX_ENABLED=y
CONFIG_ESP_WIFI_TX_BA_WIN=16
CONFIG_ESP_WIFI_RX_BA_WIN=16

# Disable power management for max throughput
CONFIG_ESP_WIFI_STA_DISCONNECTED_PM_ENABLE=n

# Cache TX buffers in PSRAM
CONFIG_ESP_WIFI_CACHE_TX_BUFFER_NUM=32

# ============================================================================
# LWIP TCP Optimizations for Speed
# ============================================================================
# Increase TCP window size for higher throughput
CONFIG_LWIP_TCP_WND_DEFAULT=32768
CONFIG_LWIP_TCP_SND_BUF_DEFAULT=32768
CONFIG_LWIP_TCP_RECVMBOX_SIZE=32
# MSS
CONFIG_LWIP_TCP_MSS=1440
# Disable Nagle (faster small packets)
CONFIG_LWIP_TCP_NODELAY=y
# SO_REUSE
CONFIG_LWIP_SO_REUSE=y
```

## examples/esp/https_speed_test/c/sdkconfig.defaults
```kconfig
# ESP32-S3 with PSRAM
CONFIG_IDF_TARGET="esp32s3"
CONFIG_SPIRAM=y
CONFIG_SPIRAM_MODE_OCT=y
CONFIG_SPIRAM_SPEED_80M=y

# WiFi
CONFIG_WIFI_SSID="HAIVIVI-MFG"
CONFIG_WIFI_PASSWORD="!haivivi"

# Test Server
CONFIG_TEST_SERVER_IP="192.168.4.221"

# Disable unused
CONFIG_BT_ENABLED=n
```

## examples/esp/https_speed_test/zig/main/Kconfig.projbuild
```kconfig
menu "HTTPS Speed Test Configuration"

    config WIFI_SSID
        string "WiFi SSID"
        default "myssid"

    config WIFI_PASSWORD
        string "WiFi Password"
        default "mypassword"

    config TEST_SERVER_IP
        string "Test Server IP"
        default "192.168.1.100"

endmenu
```

## examples/esp/led_strip_anim/zig/main/Kconfig.projbuild
```kconfig
menu "LED Strip Animation Example"

    config BOARD_NAME
        string "Board name"
        default "korvo2_v3"
        help
            Select the target board:
            - korvo2_v3: ESP32-S3-Korvo-2 V3 (12 LEDs on GPIO19)
            - esp32s3_devkit: ESP32-S3 DevKitC (1 LED on GPIO48)

endmenu
```

## examples/esp/led_strip_anim/zig/sdkconfig.defaults
```kconfig
# LED Strip Animation Example Configuration

# ESP32-S3 target
CONFIG_IDF_TARGET="esp32s3"
CONFIG_ESPTOOLPY_FLASHSIZE_2MB=y
CONFIG_SPIRAM=y
CONFIG_SPIRAM_MODE_OCT=y
CONFIG_SPIRAM_SPEED_80M=y

# Board selection
CONFIG_BOARD_NAME="korvo2_v3"

# Stack size for main task (HAL controller needs more stack)
CONFIG_ESP_MAIN_TASK_STACK_SIZE=8192

# Compiler optimizations
CONFIG_COMPILER_OPTIMIZATION_SIZE=y

# Logging
CONFIG_LOG_DEFAULT_LEVEL_INFO=y
```

## examples/esp/led_strip_flash/c/main/Kconfig.projbuild
```kconfig
menu "LED Strip Flash Example Configuration"

    config BLINK_GPIO
        int "Blink GPIO number"
        range 0 48
        default 48
        help
            GPIO number for the LED strip data pin.

    config BLINK_PERIOD
        int "Blink period in ms"
        range 10 3600000
        default 1000
        help
            Define the blinking period in milliseconds.

endmenu
```

## examples/esp/led_strip_flash/zig/main/Kconfig.projbuild
```kconfig
menu "LED Strip Flash Example"

    config BLINK_PERIOD
        int "Blink period in ms"
        range 10 3600000
        default 1000
        help
            Define the blinking period in milliseconds.

endmenu
```

## examples/esp/memory_attr_test/c/main/Kconfig.projbuild
```kconfig
menu "Memory Attribute Test Configuration"

    config TEST_PSRAM_ARRAY_SIZE
        int "PSRAM test array size (bytes)"
        default 4096
        help
            Size of the test array to be placed in PSRAM.

    config TEST_IRAM_ITERATIONS
        int "IRAM function test iterations"
        default 1000
        help
            Number of iterations for IRAM function performance test.

endmenu
```

## examples/esp/memory_attr_test/c/sdkconfig.defaults
```kconfig
# ESP32-S3-DevKitC-1 with PSRAM
CONFIG_IDF_TARGET="esp32s3"
CONFIG_ESPTOOLPY_FLASHSIZE_2MB=y
CONFIG_SPIRAM=y
CONFIG_SPIRAM_MODE_OCT=y
CONFIG_SPIRAM_SPEED_80M=y
CONFIG_SPIRAM_ALLOW_BSS_SEG_EXTERNAL_MEMORY=y

# Compiler optimizations
CONFIG_COMPILER_OPTIMIZATION_SIZE=y

# Logging
CONFIG_LOG_DEFAULT_LEVEL_INFO=y

# Test configuration
CONFIG_TEST_PSRAM_ARRAY_SIZE=4096
CONFIG_TEST_IRAM_ITERATIONS=1000
```

## examples/esp/mic_test/zig/sdkconfig.defaults
```kconfig
# ESP32-S3-Korvo-2 V3 with PSRAM
CONFIG_IDF_TARGET="esp32s3"
CONFIG_ESPTOOLPY_FLASHSIZE_4MB=y
CONFIG_SPIRAM=y
CONFIG_SPIRAM_MODE_OCT=y
CONFIG_SPIRAM_SPEED_80M=y

# Compiler optimizations
CONFIG_COMPILER_OPTIMIZATION_SIZE=y

# Logging
CONFIG_LOG_DEFAULT_LEVEL_INFO=y

# Stack size for main task (needs extra for I2S TDM + mic buffer)
CONFIG_ESP_MAIN_TASK_STACK_SIZE=16384

# I2S configuration
CONFIG_I2S_SUPPRESS_DEPRECATE_WARN=y
```

## examples/esp/wifi_dns_lookup/c/main/Kconfig.projbuild
```kconfig
menu "WiFi DNS Lookup Configuration"

    config WIFI_SSID
        string "WiFi SSID"
        default "HAIVIVI-MFG"
        help
            WiFi SSID to connect to.

    config WIFI_PASSWORD
        string "WiFi Password"
        default "!haivivi"
        help
            WiFi password.

endmenu
```

## examples/esp/wifi_dns_lookup/c/sdkconfig.defaults
```kconfig
# ESP32-S3-DevKitC-1 with PSRAM
CONFIG_IDF_TARGET="esp32s3"
CONFIG_ESPTOOLPY_FLASHSIZE_2MB=y
CONFIG_SPIRAM=y
CONFIG_SPIRAM_MODE_OCT=y
CONFIG_SPIRAM_SPEED_80M=y

# CPU Frequency 240MHz
CONFIG_ESP32S3_DEFAULT_CPU_FREQ_240=y
CONFIG_ESP32S3_DEFAULT_CPU_FREQ_MHZ=240

# Run code from PSRAM (reduces IRAM usage)
CONFIG_SPIRAM_FETCH_INSTRUCTIONS=y
CONFIG_SPIRAM_RODATA=y

# Compiler optimizations
CONFIG_COMPILER_OPTIMIZATION_SIZE=y

# WiFi
CONFIG_WIFI_SSID="HAIVIVI-MFG"
CONFIG_WIFI_PASSWORD="!haivivi"

# HTTP Client for DoH
CONFIG_ESP_HTTP_CLIENT_ENABLE_HTTPS=y
CONFIG_ESP_HTTP_CLIENT_ENABLE_BASIC_AUTH=n

# mbedTLS CA bundle for HTTPS (DoH)
CONFIG_MBEDTLS_CERTIFICATE_BUNDLE=y
CONFIG_MBEDTLS_CERTIFICATE_BUNDLE_DEFAULT_FULL=y

# TLS configuration
CONFIG_MBEDTLS_SSL_MAX_CONTENT_LEN=16384
CONFIG_MBEDTLS_ASYMMETRIC_CONTENT_LEN=y
CONFIG_MBEDTLS_SSL_IN_CONTENT_LEN=16384
CONFIG_MBEDTLS_SSL_OUT_CONTENT_LEN=4096

# Disable unused
CONFIG_BT_ENABLED=n

# Increase task stack
CONFIG_ESP_MAIN_TASK_STACK_SIZE=8192

# Use PSRAM for WiFi/LWIP buffers
CONFIG_SPIRAM_TRY_ALLOCATE_WIFI_LWIP=y
```

## examples/http_speed_test/zig/main/Kconfig.projbuild
```kconfig
menu "HTTP Speed Test Configuration"

    config WIFI_SSID
        string "WiFi SSID"
        default "HAIVIVI-MFG"
        help
            WiFi SSID to connect to.

    config WIFI_PASSWORD
        string "WiFi Password"
        default "!haivivi"
        help
            WiFi password.

    config TEST_SERVER_IP
        string "Test Server IP"
        default "192.168.1.100"
        help
            IP address of the speed test server.

    config TEST_SERVER_PORT
        int "Test Server Port"
        default 8080
        help
            Port of the speed test server.

endmenu
```

## examples/http_speed_test/zig/sdkconfig.defaults
```kconfig
# Enable PSRAM
CONFIG_SPIRAM=y
CONFIG_SPIRAM_MODE_OCT=y
CONFIG_ESP32S3_SPIRAM_SUPPORT=y

# WiFi
CONFIG_WIFI_SSID="HAIVIVI-MFG"
CONFIG_WIFI_PASSWORD="!haivivi"

# Test Server
CONFIG_TEST_SERVER_IP="192.168.1.7"
CONFIG_TEST_SERVER_PORT=8080

# HTTP Client
CONFIG_ESP_HTTP_CLIENT_ENABLE_HTTPS=n
CONFIG_ESP_HTTP_CLIENT_ENABLE_BASIC_AUTH=n

# Disable unused
CONFIG_BT_ENABLED=n

# Increase task stack for HTTP
CONFIG_ESP_MAIN_TASK_STACK_SIZE=8192

# ============================================================================
# WiFi Optimizations for Speed
# ============================================================================
# Increase WiFi static RX buffer
CONFIG_ESP_WIFI_STATIC_RX_BUFFER_NUM=16
# Increase WiFi dynamic RX buffer
CONFIG_ESP_WIFI_DYNAMIC_RX_BUFFER_NUM=64
# Increase WiFi TX buffer
CONFIG_ESP_WIFI_DYNAMIC_TX_BUFFER_NUM=64
# WiFi AMPDU settings
CONFIG_ESP_WIFI_RX_BA_WIN=16
CONFIG_ESP_WIFI_AMPDU_TX_ENABLED=y
CONFIG_ESP_WIFI_AMPDU_RX_ENABLED=y

# ============================================================================
# LWIP TCP Optimizations for Speed
# ============================================================================
# Increase TCP window size for higher throughput
CONFIG_LWIP_TCP_WND_DEFAULT=32768
CONFIG_LWIP_TCP_SND_BUF_DEFAULT=32768
CONFIG_LWIP_TCP_RECVMBOX_SIZE=32
# MSS
CONFIG_LWIP_TCP_MSS=1440
# Disable Nagle (faster small packets)
CONFIG_LWIP_TCP_NODELAY=y
# SO_REUSE
CONFIG_LWIP_SO_REUSE=y
```

## examples/http_speed_test/zig_std/sdkconfig.defaults
```kconfig
# ESP32-S3-DevKitC-1 with PSRAM
CONFIG_IDF_TARGET="esp32s3"
CONFIG_ESPTOOLPY_FLASHSIZE_2MB=y
CONFIG_SPIRAM=y
CONFIG_SPIRAM_MODE_OCT=y
CONFIG_SPIRAM_SPEED_80M=y

# CPU Frequency 240MHz
CONFIG_ESP32S3_DEFAULT_CPU_FREQ_240=y
CONFIG_ESP32S3_DEFAULT_CPU_FREQ_MHZ=240

# Run code from PSRAM (reduces IRAM usage)
CONFIG_SPIRAM_FETCH_INSTRUCTIONS=y
CONFIG_SPIRAM_RODATA=y

# Compiler optimizations
CONFIG_COMPILER_OPTIMIZATION_SIZE=y

# WiFi
CONFIG_WIFI_SSID="HAIVIVI-MFG"
CONFIG_WIFI_PASSWORD="!haivivi"

# Test Server
CONFIG_TEST_SERVER_IP="192.168.4.221"
CONFIG_TEST_SERVER_PORT=8080

# Disable unused components
CONFIG_BT_ENABLED=n

# Note: This version does NOT use esp_http_client
# It uses pure Zig HTTP client with LWIP sockets

# Main task stack (HTTP runs on separate PSRAM stack task)
CONFIG_ESP_MAIN_TASK_STACK_SIZE=8192

# ============================================================================
# WiFi Optimizations for Speed
# ============================================================================
# Use PSRAM for WiFi/LWIP buffers (reduces internal RAM pressure)
CONFIG_SPIRAM_TRY_ALLOCATE_WIFI_LWIP=y

# WiFi RX buffers
CONFIG_ESP_WIFI_STATIC_RX_BUFFER_NUM=16
CONFIG_ESP_WIFI_DYNAMIC_RX_BUFFER_NUM=64

# WiFi TX buffers  
CONFIG_ESP_WIFI_DYNAMIC_TX_BUFFER_NUM=64

# WiFi AMPDU settings (increase TX window for better throughput)
CONFIG_ESP_WIFI_AMPDU_TX_ENABLED=y
CONFIG_ESP_WIFI_AMPDU_RX_ENABLED=y
CONFIG_ESP_WIFI_TX_BA_WIN=16
CONFIG_ESP_WIFI_RX_BA_WIN=16

# Disable power management for max throughput
CONFIG_ESP_WIFI_STA_DISCONNECTED_PM_ENABLE=n

# Cache TX buffers in PSRAM
CONFIG_ESP_WIFI_CACHE_TX_BUFFER_NUM=32

# ============================================================================
# LWIP TCP Optimizations for Speed
# ============================================================================
CONFIG_LWIP_TCP_WND_DEFAULT=32768
CONFIG_LWIP_TCP_SND_BUF_DEFAULT=32768
CONFIG_LWIP_TCP_RECVMBOX_SIZE=32
CONFIG_LWIP_TCP_MSS=1440
CONFIG_LWIP_TCP_NODELAY=y
CONFIG_LWIP_SO_REUSE=y

# Enable POSIX socket API
CONFIG_LWIP_POSIX_SOCKETS_IO_NAMES=y
```

## examples/led_strip_flash/c/sdkconfig.defaults
```kconfig
# Target ESP32-S3
CONFIG_IDF_TARGET="esp32s3"

# LED Strip Flash Configuration
CONFIG_BLINK_GPIO=48
CONFIG_BLINK_PERIOD=1000
```

## examples/memory_attr_test/c/sdkconfig.defaults
```kconfig
# Enable PSRAM
CONFIG_SPIRAM=y
CONFIG_SPIRAM_MODE_OCT=y
CONFIG_SPIRAM_ALLOW_BSS_SEG_EXTERNAL_MEMORY=y

# Test configuration
CONFIG_TEST_PSRAM_ARRAY_SIZE=4096
CONFIG_TEST_IRAM_ITERATIONS=1000
```

## examples/wifi_dns_lookup/zig/sdkconfig.defaults
```kconfig
# Target ESP32-S3
CONFIG_IDF_TARGET="esp32s3"

# WiFi configuration
CONFIG_WIFI_SSID="HAIVIVI-MFG"
CONFIG_WIFI_PASSWORD="!haivivi"

# Increase stack size for WiFi tasks
CONFIG_ESP_MAIN_TASK_STACK_SIZE=8192
```
